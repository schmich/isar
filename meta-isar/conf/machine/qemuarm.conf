## meta-isar/conf/machine/qemuarm.conf
```bitbake
# This software is a part of ISAR.
# Copyright (C) 2015-2016 ilbers GmbH

IMAGE_PREINSTALL = "          \
    init                      \
    linux-image-4.9.0-3-armmp \
"

KERNEL_IMAGE = "vmlinuz-4.9.0-3-armmp"
INITRD_IMAGE = "initrd.img-4.9.0-3-armmp"

MACHINE_SERIAL = "ttyAMA0"
ROOTFS_DEV = "mmcblk0"
BAUDRATE_TTY = "9600"

IMAGE_TYPE = "ext4-img"
```
